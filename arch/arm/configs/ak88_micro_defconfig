## arch/arm/mach-ak88/Kconfig
```kconfig
if ARCH_AK88

choice
	prompt "AK88 boards"
	default ARCH_AK8802EBOOK

config BOARD_AK8801EPC
	bool "EPC board based on AK8801"
	depends on ARCH_AK88
	help
	  Say Y here if you are using the EPC board based on AK8801.

config BOARD_AK8802EBOOK
	bool "EBOOK board based on AK8802"
	depends on ARCH_AK88
	help
	  Say Y here if you are using the EBOOK board on AK8802.

endchoice

config AK88_PWM
	bool "PWM control driver for AK88"
	depends on ARCH_AK88
	help
	  Say Y here if you want support pwm control.

config AK88_PM
	bool "power management for AK88"
	depends on PM && ARCH_AK88
	help
	  Say Y here if you want support power management for AK88.

endif
```

## arch/arm/mach-ak98/Kconfig
```kconfig
if ARCH_AK98

choice
	prompt "AK98XX boards"
	default AK9801_ATHENA

config AK9801_ATHENA
	bool "ATHENA based on AK9801"
	depends on ARCH_AK98
	help
	  Say Y here if you are using the ATHENA board based on AK9801.

config AK9805_TV908
	bool "TV908 based on AK9805"
	depends on ARCH_AK98
	help
	  Say Y here if you are using the TV908 board on AK9805.

config AK9805_MP5
	bool "Smart MP5 based on AK9805"
	depends on ARCH_AK98
	help
	  Say Y here if you are using the MP5 board on AK9805.

endchoice

config AK98_PWM
	bool "PWM control driver for AK98"
	depends on ARCH_AK98
	help
	  Say Y here if you want support pwm control.

config AK98_PM
	bool "AK98 CPU Power Management support"
	depends on PM && ARCH_AK98
	help
	  Say Y here if you want support power management for AK98.

config AK98_CPUFREQ
	bool "AK98 CPU Frequency scaling support"
	depends on CPU_FREQ && ARCH_AK98
	help
	  Say Y here, CPU Frequency scaling support for AK98 SoC CPUs.

endif
```

## drivers/mmc/host/ak88-mmc/Kconfig
```kconfig
config MMC_AK88
    tristate "AK88 AK7801 MMC/SD Card Interface support"
    depends on ARCH_AK88
    help
      This selects the AK88 AK7801 MMC/SD card Interface.
      say Y or M here.
      If unsure, say N.
```

## drivers/mmc/host/ak98-mmc/Kconfig
```kconfig
config MMC_AK98
    tristate "AK98  MMC/SD/SDIO Card Interface support"
    depends on ARCH_AK98
    help
      This selects the AK98 MMC/SD card Interface.
      say Y or M here.
      If unsure, say N.

choice 
	prompt "MMC/SD Data line select"
	depends on MMC_AK98
	default FOUR_DATA_LINE

config FOUR_DATA_LINE
	bool "four data line mmc/sd slot"

config EIGHT_DATA_LINE
	bool "eight data line mmc/sd slot"
endchoice

config SDIO_DEVICE_SLOT
    tristate "AK98 SDIO Card slot"
	default N
    help
      This selects the AK98 sdio card Interface.
      say Y or M here.
      If unsure, say N.
```

## drivers/net/ak98-mac/Kconfig
```kconfig
config AK98_MAC
	tristate "AK98 MAC Device"
	depends on ARCH_AK98
	help
	  AK98 MAC device support
```

## drivers/usb/gadget/ak88-udc/Kconfig
```kconfig
config USB_GADGET_AK88
	boolean "AK88 USB Device Port"
	depends on ARCH_AK88
	select USB_GADGET_SELECTED
	select USB_GADGET_DUALSPEED
	help
	  AK88 OTG device support

config USB_AK88
	tristate
	depends on USB_GADGET_AK88
	default USB_GADGET
```

## drivers/usb/gadget/ak98-udc/Kconfig
```kconfig
config USB_GADGET_AK98_PRODUCER
	boolean "AK98 USB Device Port for PRODUCER"
	depends on ARCH_AK98
	select USB_GADGET_SELECTED
	select USB_GADGET_DUALSPEED
	help
	  AK98 OTG device support for producer

if USB_GADGET_AK98_PRODUCER
config USB_AK98_PRODUCER
	tristate
	default m
endif

config USB_GADGET_AK98
	boolean "AK98 USB Device Port"
	depends on ARCH_AK98
	select USB_GADGET_SELECTED
	select USB_GADGET_DUALSPEED
	help
	  AK98 OTG device support

if USB_GADGET_AK98
config USB_AK98
	tristate
	default y 
endif
```

## drivers/video/ak88-fb/Kconfig
```kconfig
config FB_AK88
    tristate "AK88 LCD framebuffer support"
    depends on FB && ARCH_AK88
    select FB_CFB_FILLRECT
    select FB_CFB_COPYAREA
    select FB_CFB_IMAGEBLIT
    help
      Frame buffer driver for the built-in LCD controller in the AK88
      processor.

      If unsure, Say N.

config FB_AK88_DEBUG
    bool "AK88 lcd debug messages"
    depends on FB_AK88
    help
      Turn on debugging messages. Note that you set/unset at run time
      through sysfs.
```
